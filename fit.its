## fit.its
```
/dts-v1/;

/ {
        description = "Cudy X6";
        #address-cells = <1>;

        images {
                kernel {
                        description = "Kernel";
                        data = /incbin/("@kernel@");
                        type = "kernel";
                        arch = "mips";
                        os = "linux";
                        compression = "none";
                        load = <@kernelAddress@>;
                        entry = <@kernelAddress@>;
                        hash {
                                algo = "sha1";
                        };
                };
                fdt {
                        description = "DTB";
                        data = /incbin/("@dtb@");
                        type = "flat_dt";
                        arch = "mips";
			load = <@dtbAddress@>;
			entry = <@dtbAddress@>;
                        compression = "none";
                        hash {
                                algo = "sha1";
                        };
                };
                initrd {
                        description = "Initrd";
                        data = /incbin/("@initrd@");
                        type = "ramdisk";
                        arch = "mips";
                        os = "linux";
			load = <@initrdAddress@>;
			entry = <@initrdAddress@>;
                        compression = "none";
                        hash {
                                algo = "sha1";
                        };
                };
        };

        configurations {
                default = "standard";
                standard {
                        description = "Standard Boot";
                        kernel = "kernel";
                        fdt = "fdt";
                        ramdisk = "initrd";
                        hash {
                                algo = "sha1";
                        };
                };
        };

};
```
